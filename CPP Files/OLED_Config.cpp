#include"OLED_Config.h"

// TaskHandle_t DisplayTaskHandle = NULL;
//----------Create an instance of Adafruit_SH110X.h library type Adafruit_SH1106G---------//
Adafruit_SH1106G OLED = Adafruit_SH1106G(SCREEN_WIDTH, SCREEN_HEIGHT, &Wire, OLED_RESET);

//----------Create an instance of u8g2 library---------//
// For I2C SH1106 128x64 or SSD1306 128x64
// U8G2_SH1106_128X64_NONAME_F_HW_I2C u8g2(U8G2_R0, /* reset=*/ U8X8_PIN_NONE);
// Or try this for SSD1306:
// U8G2_SSD1306_128X64_NONAME_F_HW_I2C u8g2(U8G2_R0, /* reset=*/ U8X8_PIN_NONE);

bool denied = false;
bool show   = false;
bool clc    = false;
bool errorSign = false;
String errorMsg; 

const uint8_t okIcon[] = {
	0xff, 0xff, 0xff, 0xff, 0xff, 0xf8, 0xff, 0xff, 0xff, 0xff, 0xff, 0xf8, 0xff, 0xff, 0xff, 0xff, 
	0xff, 0xf8, 0xff, 0xff, 0x00, 0x07, 0xff, 0xf8, 0xff, 0xf8, 0x00, 0x00, 0xff, 0xf8, 0xff, 0xf0, 
	0x00, 0x00, 0x7f, 0xf8, 0xff, 0xc0, 0x00, 0x00, 0x1f, 0xf8, 0xff, 0x80, 0x00, 0x00, 0x0f, 0xf8, 
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	0xff, 0xff, 0xff, 0xf8, 0xff, 0xff, 0xff, 0xff, 0xff, 0xf8, 0xff, 0xff, 0xff, 0xff, 0xff, 0xf8
};

const uint8_t errorIcon[] = {
	0xff, 0xff, 0xff, 0xff, 0xff, 0xf8, 0xff, 0xff, 0xff, 0xff, 0xff, 0xf8, 0xff, 0xff, 0xff, 0xff, 
	0xff, 0xf8, 0xff, 0xff, 0xff, 0xff, 0xff, 0xf8, 0xff, 0xff, 0xfd, 0xff, 0xff, 0xf8, 0xff, 0xff, 
	0xf0, 0x3f, 0xff, 0xf8, 0xff, 0xff, 0xef, 0x9f, 0xff, 0xf8, 0xff, 0xff, 0xdf, 0xdf, 0xff, 0xf8, 
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	0xff, 0xff, 0xff, 0xf8, 0xff, 0xff, 0xff, 0xff, 0xff, 0xf8, 0xff, 0xff, 0xff, 0xff, 0xff, 0xf8
};

const uint8_t wifi[] = { // Size 24x20 pixels
  0xff, 0x80, 0xff, 0x80, 0xfc, 0x00, 0x1f, 0x80, 0xf0, 0x00, 0x07, 0x80, 0xe0, 0xff, 0x83, 0x80, 
	0xc3, 0xff, 0xe1, 0x80, 0x8f, 0xe3, 0xf8, 0x80, 0x1f, 0x00, 0x7c, 0x00, 0xbc, 0x00, 0x1e, 0x80, 
	0xf8, 0x3e, 0x0f, 0x80, 0xf0, 0xff, 0x87, 0x80, 0xf1, 0xff, 0xc7, 0x80, 0xfb, 0x80, 0xef, 0x80, 
	0xff, 0x00, 0x7f, 0x80, 0xfe, 0x1c, 0x3f, 0x80, 0xff, 0x3e, 0x7f, 0x80, 0xff, 0xff, 0xff, 0x80, 
	0xff, 0xe3, 0xff, 0x80, 0xff, 0xe3, 0xff, 0x80, 0xff, 0xe3, 0xff, 0x80
};

const uint8_t NOwifi[] = {
  0xff, 0xff, 0xff, 0x80, 0xff, 0x01, 0xff, 0x80, 0xf8, 0x00, 0x7f, 0x80, 0xf1, 0xff, 0x1f, 0x80, 
	0xc7, 0xff, 0xc7, 0x80, 0x9f, 0x01, 0xf3, 0x80, 0xbc, 0x38, 0xfb, 0x80, 0xf9, 0xff, 0x87, 0x80, 
	0xf3, 0xfe, 0x03, 0x80, 0xf7, 0x86, 0x01, 0x80, 0xfe, 0x3c, 0x84, 0x80, 0xfc, 0xfc, 0x48, 0x80, 
	0xff, 0xf8, 0x30, 0x80, 0xff, 0xec, 0x30, 0x80, 0xff, 0xcc, 0x48, 0x80, 0xff, 0xc4, 0x84, 0x80, 
	0xff, 0xfe, 0x01, 0x80, 0xff, 0xff, 0x03, 0x80, 0xff, 0xff, 0xff, 0x80
};

const uint8_t logo[1024] = {
  0xff, 0xff, 0xff, 0xff, 0xff, 0xff, 0xff, 0xff, 0xff, 0xff, 0xff, 0xff, 0xff, 0xff, 0xff, 0xff, 
  0xff, 0xff, 0xff, 0xff, 0xff, 0xff, 0xff, 0xff, 0xff, 0xff, 0xff, 0xff, 0xff, 0xff, 0xff, 0xff, 
  0xff, 0xff, 0xff, 0xff, 0xff, 0xff, 0xff, 0xff, 0xff, 0xff, 0xff, 0xff, 0xff, 0xff, 0xff, 0xff, 
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  0xff, 0xff, 0xff, 0xff, 0xff, 0xff, 0xff, 0xff, 0xff, 0xff, 0xff, 0xff, 0xff, 0xff, 0xff, 0xff
};

const uint8_t fingerprint_OKicon [1025] = {
  0xff, 0xff, 0xff, 0xff, 0xff, 0xff, 0xff, 0xff, 0xff, 0xff, 0xff, 0xff, 0xff, 0xff, 0xff, 0xff, 
  0xff, 0xff, 0xff, 0xff, 0xff, 0xff, 0xff, 0xff, 0xff, 0xff, 0xff, 0xff, 0xff, 0xff, 0xff, 0xff, 
  0xff, 0xff, 0xff, 0xff, 0xff, 0xff, 0xff, 0xff, 0xff, 0xff, 0xff, 0xff, 0xff, 0xff, 0xff, 0xff, 
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  0xff, 0xff, 0xff, 0xff, 0xff, 0xff, 0xff, 0xff, 0xff, 0xff, 0xff, 0xff, 0xff, 0xff, 0xff, 0xff
};

const uint8_t fingerprint_icon[1024] = {
  0xff, 0xff, 0xff, 0xff, 0xff, 0xff, 0xff, 0xff, 0xff, 0xff, 0xff, 0xff, 0xff, 0xff, 0xff, 0xff, 
  0xff, 0xff, 0xff, 0xff, 0xff, 0xff, 0xff, 0xff, 0xff, 0xff, 0xff, 0xff, 0xff, 0xff, 0xff, 0xff, 
  0xff, 0xff, 0xff, 0xff, 0xff, 0xff, 0xff, 0xff, 0xff, 0xff, 0xff, 0xff, 0xff, 0xff, 0xff, 0xff, 
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  0xff, 0xff, 0xff, 0xff, 0xff, 0xff, 0xff, 0xff, 0xff, 0xff, 0xff, 0xff, 0xff, 0xff, 0xff, 0xff
};

void OLED_Config(){
  
  OLED.begin(oled_address, true);
  OLED.display(); // Display initial buffer contents
  delay(100);
  OLED.clearDisplay(); // Clear buffer

}

void DisplayDateTime(String DeviceID, const uint8_t* image, int life, int level){
  if(!denied){
    OLED.clearDisplay();

    OLED.drawBitmap(0, 0, image, 25, 19, 1); //WiFi or NOWiFi logo
    OLED.fillTriangle(55, 2, 65, 2, 60, 7, 1);
    OLED.fillRect(60, 7, 2, 6, 1);
    
    OLED.drawRect(113, 3, 15, 11, 1);
    OLED.fillRect(111, 6, 3, 5, 1);

    if(life>=0 && life<=35) OLED.fillRect(123, 3, 5, 11, 1);
    else if(life>35 && life<=65) OLED.fillRect(118, 3, 10, 11, 1); //Battery Level indictor
    else OLED.fillRect(113, 3, 15, 11, 1);

    if(level>=0 && level<=1) OLED.fillRect(70, 8, 2, 6, 1);
    else if(level>1 && level<=20) {OLED.fillRect(70, 8, 2, 6, 1); OLED.fillRect(74, 4, 2, 10, 1);} //Network Level indictor
    else if(level>20 && level<=31) {OLED.fillRect(70, 8, 2, 6, 1); OLED.fillRect(74, 4, 2, 10, 1); OLED.fillRect(78, 0, 2, 14, 1);}
    else {OLED.fillRect(78, 0, 2, 14, 1);}

    OLED.setTextColor(SH110X_WHITE);
    OLED.setTextSize(1);
    OLED.setCursor(38, 20);
    OLED.println(currTime); // Display Current Time

    OLED.setTextSize(1);
    OLED.setCursor(15, 35);
    OLED.println(currDate); // Display Current Date

    OLED.setCursor(58, 50);
    OLED.println(DeviceID); //Display Device ID
    OLED.display();

  }
}

void DisplayRec(int life){
  OLED.clearDisplay();

  OLED.drawRect(113, 0, 15, 11, 1);
  OLED.fillRect(111, 3, 3, 5, 1);

  if(life>0 && life<=35) OLED.fillRect(123, 0, 5, 11, 1);
  else if(life>35 && life<=65) OLED.fillRect(118, 0, 10, 11, 1);
  else OLED.fillRect(113, 0, 15, 11, 1);
  
  OLED.display();
}

void DisplayImage(int x, int y, int h, int w, const uint8_t* image){
  if(!denied){
    OLED.clearDisplay();
    OLED.drawBitmap(x, y, image, w, h, 1);
    OLED.display();
  }
}

void DisplayText(int x, int y, float size, bool flag, const char* text){
  if(!denied){
    if(flag){
      OLED.clearDisplay();
    }
    OLED.setTextSize(size);
    OLED.setTextColor(SH110X_WHITE);
    OLED.setCursor(x, y);
    OLED.print(text);
    OLED.display();
  }
}

unsigned long lastScrollTime = 0;
const int scrollDelay = 5;  // in milliseconds
int scrollOffset = SCREEN_HEIGHT;

void DisplayScrollingText(char* menu[], const int numLines){

  const int lineHeight = 18; // pixel height per line
  // const int numLines = sizeof(menu) / sizeof(menu[0]);
  const int totalHeight = numLines * lineHeight;

  if(!denied){
    if (millis() - lastScrollTime >= scrollDelay) {
      lastScrollTime = millis();
      OLED.clearDisplay();
      for(int i = 0; i < numLines; i++){
        int y = i * lineHeight + scrollOffset;
        if(y >= -lineHeight && y <= SCREEN_HEIGHT){
          OLED.setCursor(0, y);
          // OLED.println(menu[i]);
          // Serial.printf("%d: %s\n", (i + 1), menu[i]);
          OLED.printf("%d.%s\n", (i+1), menu[i]);
        }
      }
      
      OLED.display();
      scrollOffset--; // Scroll upward
      // Restart scrolling after done
      if (scrollOffset <= -totalHeight) {
        scrollOffset = SCREEN_HEIGHT;
      }
    }
  }

}

